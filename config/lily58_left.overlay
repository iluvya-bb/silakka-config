/ {
    chosen {
        zmk,display = &nice_view;
    };
};

/* Wake up the SPI bus and define the Chip Select pin for the nice!view */
&pro_micro_spi {
    status = "okay";
    cs-gpios = <&pro_micro 1 GPIO_ACTIVE_HIGH>;
};

&nice_view {
    status = "okay";
};
